/dts-v1/;
/plugin/;

/ {
    fragment@0 {
        target-path = "/";
        __overlay__ {
            axi_dma: dma@40400000 {
                compatible = "xlnx,axi-dma-custom";
                /* 
                 * Reg 0: Xilinx AXI DMA registers (0x40400000, 64 KB)
                 * Reg 1: Custom BRAM IP window    (0x40000000, 4 KB)
                 */
                reg = <0x40400000 0x10000>, <0x40000000 0x1000>;
                reg-names = "dma", "bram_ip";
                interrupt-parent = <&intc>;
                /* 
                 * 0 = SPI
                 * 29 = SPI 29 (HW IRQ 61, RX/S2MM DMA done)
                 * 30 = SPI 30 (HW IRQ 62, TX/MM2S DMA done)
                 * 31 = SPI 31 (HW IRQ 63, Custom BRAM IP compute done / error)
                 * 4 = IRQ_TYPE_LEVEL_HIGH
                 */
                interrupts = <0 29 4>, <0 30 4>, <0 31 4>;
                interrupt-names = "rx", "tx", "ip_done";
                status = "okay";
            };
        };
    };
};